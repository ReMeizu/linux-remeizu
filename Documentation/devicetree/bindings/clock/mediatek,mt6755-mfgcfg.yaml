## Documentation/devicetree/bindings/clock/mediatek,mt6755-mfgcfg.yaml
```yaml
# SPDX-License-Identifier: GPL-2.0-only
%YAML 1.2
---
$id: http://devicetree.org/schemas/clock/mediatek,mt6755-mfgcfg.yaml#
$schema: http://devicetree.org/meta-schemas/core.yaml#

title: MediaTek MT6755/MT6750 mfgcfg (GFX) clock gate

maintainers:
  - Matthias Brugger <matthias.bgg@gmail.com>
  - AngeloGioacchino Del Regno <angelogioacchino.delregno@collabora.com>

description: |
  The mfgcfg block of the MT6755/MT6750 SoC holds the gate of the GPU
  (Mali-T860MP2) core clock, MFG_BG3D. Its parent is the topckgen "mfg_sel"
  mux, which is fed by either MPLL or one of the system/univ PLL dividers.

  The gate registers live at 0x13000000, inside the MFG_ASYNC MTCMOS
  domain, so the block is only reachable while that domain is powered.
  The provider is registered without runtime PM on purpose: the domain is
  brought up by the GPU consumer (panfrost, through its "mfg"
  power-domains entry) before it enables the GPU clock.

properties:
  compatible:
    const: mediatek,mt6755-mfgcfg

  reg:
    maxItems: 1

  '#clock-cells':
    const: 1

  clocks:
    maxItems: 1
    description: Parent of the MFG_BG3D gate (topckgen "mfg_sel" mux).

  clock-names:
    const: mfg

  power-domains:
    maxItems: 1
    description:
      MFG_ASYNC MTCMOS domain. Optional; see the description for the
      ordering reason why the gate is normally registered without it.

required:
  - compatible
  - reg
  - '#clock-cells'

additionalProperties: false

examples:
  - |
    clock-controller@13000000 {
        compatible = "mediatek,mt6755-mfgcfg";
        reg = <0x13000000 0x1000>;
        #clock-cells = <1>;
    };
```

## Documentation/devicetree/bindings/clock/mediatek,mt6797-mfgcfg.yaml
```yaml
# SPDX-License-Identifier: GPL-2.0-only
%YAML 1.2
---
$id: http://devicetree.org/schemas/clock/mediatek,mt6797-mfgcfg.yaml#
$schema: http://devicetree.org/meta-schemas/core.yaml#

title: MediaTek MT6797 mfgcfg (GFX) clock gate

description: |
  The mfgcfg block of the MT6797 SoC holds the gate of the GPU
  (Mali-T880MP4) core clock, MFG_BG3D. Its parent is the topckgen
  "mfg_sel" mux, fed by the apmixedsys MFGPLL and its dividers.

  The gate registers live at 0x13000000, inside the MFG_ASYNC MTCMOS
  domain, so the block is only reachable while that domain is powered.
  The provider is registered without runtime PM on purpose: the domain is
  brought up by the GPU consumer (panfrost, through its "mfg"
  power-domains entry) before it enables the GPU clock.

properties:
  compatible:
    const: mediatek,mt6797-mfgcfg

  reg:
    maxItems: 1

  '#clock-cells':
    const: 1

required:
  - compatible
  - reg
  - '#clock-cells'

additionalProperties: false

examples:
  - |
    clock-controller@13000000 {
        compatible = "mediatek,mt6797-mfgcfg";
        reg = <0x13000000 0x1000>;
        #clock-cells = <1>;
    };
```

## Documentation/devicetree/bindings/iio/light/txc,pa12203001.yaml
```yaml
# SPDX-License-Identifier: (GPL-2.0-only OR BSD-2-Clause)
%YAML 1.2
---
$id: http://devicetree.org/schemas/iio/light/pa12203001.yaml#
$schema: http://devicetree.org/meta-schemas/core.yaml#

title: TXC PA12203001 ambient light and proximity sensor

maintainers:
  - ReMeizu <maintainers@remeizu.org>

description: |
  The TXC PA12203001 combines a 16/18 bit ambient light sensor and a
  proximity detector with an integrated IR LED, I2C address 0x1e.  The
  driver has no interrupt support; the host polls the sensor.

properties:
  compatible:
    const: txc,pa12203001

  reg:
    maxItems: 1

  interrupts:
    maxItems: 1
    description: Optional proximity/light threshold signal, currently unused.

additionalProperties: false

required:
  - compatible
  - reg

examples:
  - |
    i2c {
        #address-cells = <1>;
        #size-cells = <0>;

        light-sensor@1e {
            compatible = "txc,pa12203001";
            reg = <0x1e>;
        };
    };
...
```

## Documentation/devicetree/bindings/misc/mediatek,connsys.yaml
```yaml
# SPDX-License-Identifier: (GPL-2.0-only OR BSD-2-Clause)
%YAML 1.2
---
$id: http://devicetree.org/schemas/misc/mediatek,connsys.yaml#
$schema: http://devicetree.org/meta-schemas/core.yaml#

title: MediaTek CONSYS combo connectivity subsystem

maintainers:
  - Meizu Linux mainline project <nomorecoolnicknames@users.noreply.github.com>

description: |
  The CONSYS block is the integrated Wi-Fi / Bluetooth / GPS combo
  subsystem of the MediaTek MT6735, MT6750, MT6755 and MT6797 SoCs.  It
  contains a Cortex-M MCU running the connectivity firmware, a shared DRAM
  window used for the firmware, the HIF rings and the MCU log buffer, and
  the BTIF serial transport that carries the STP protocol.

  The node gathers the register windows needed to power the block up from
  the AP side: the CONN MCU configuration block, the AP reset generator, the
  top level clock gate, the sleep-power-manager controller and the CONN AXI
  protection unit, plus the BTIF UART and its APDMA pair.

properties:
  compatible:
    enum:
      - mediatek,mt6735-connsys
      - mediatek,mt6755-connsys
      - mediatek,mt6797-connsys

  reg:
    minItems: 6
    maxItems: 8
    description: |
      Register windows, in this order: the CONN MCU configuration block,
      the AP reset generator, topckgen, the SPM controller, the CONN AXI
      protection block, the BTIF UART and optionally the BTIF TX and RX
      APDMA blocks.

  reg-names:
    minItems: 6
    maxItems: 8
    items:
      - const: mcu
      - const: ap_rgu
      - const: topckgen
      - const: spm
      - const: axi
      - const: btif
      - const: btif_tx_dma
      - const: btif_rx_dma

  interrupts:
    minItems: 1
    maxItems: 5
    description: |
      The BTIF interrupt (data path) and optionally the BTIF APDMA
      interrupts, followed by the BGF and CONNSYS watchdog lines.

  interrupt-names:
    minItems: 1
    maxItems: 5
    items:
      - const: btif
      - const: btif_tx_dma
      - const: btif_rx_dma
      - const: bgf
      - const: wdt

  clocks:
    maxItems: 4

  clock-names:
    items:
      - const: btif
      - const: btif_dma
      - const: connsys_cfg
      - const: connsys_emi

  memory-region:
    maxItems: 1
    description: |
      Phandle to the reserved DRAM window shared with the CONNSYS MCU.
      When omitted the window configured by the boot loader is used.

  mediatek,connsys-chip-id:
    $ref: /schemas/types.yaml#/definitions/uint32
    description: |
      Chip id reported to userspace (0x6735, 0x6750, 0x6755, 0x6797).
      Defaults to 0x6735 when omitted.

  mediatek,wmt-fm-strap:
    $ref: /schemas/types.yaml#/definitions/uint32
    enum: [1, 2]
    description: |
      FM strap sent to the MCU firmware: 1 for the I2C FM part, 2 for the
      internal one.  Defaults to 2.

  status: true

required:
  - compatible
  - reg
  - reg-names

additionalProperties: false

examples:
  - |
    #include <dt-bindings/interrupt-controller/arm-gic.h>
    #include <dt-bindings/interrupt-controller/irq.h>

    connsys: connsys@18070000 {
        compatible = "mediatek,mt6735-connsys";
        reg = <0 0x18070000 0 0x1000>,
              <0 0x10007000 0 0x1000>,
              <0 0x10000000 0 0x1000>,
              <0 0x10006000 0 0x1000>,
              <0 0x18070000 0 0x1000>,
              <0 0x1100c000 0 0x1000>,
              <0 0x11000780 0 0x80>,
              <0 0x11000800 0 0x80>;
        reg-names = "mcu", "ap_rgu", "topckgen", "spm", "axi",
                    "btif", "btif_tx_dma", "btif_rx_dma";
        interrupts = <GIC_SPI 90 IRQ_TYPE_LEVEL_LOW>,
                     <GIC_SPI 111 IRQ_TYPE_LEVEL_LOW>,
                     <GIC_SPI 112 IRQ_TYPE_LEVEL_LOW>;
        interrupt-names = "btif", "btif_tx_dma", "btif_rx_dma";
        mediatek,connsys-chip-id = <0x6735>;
        status = "disabled";
    };
```

## drivers/media/platform/mediatek/mtk-cam-legacy/Kconfig
```kconfig
# SPDX-License-Identifier: GPL-2.0-only

menu "MediaTek legacy (MT6735/MT6755/MT6797) camera support"

config VIDEO_MTK_CAM_LEGACY
	tristate "MediaTek legacy Seninf/CamSV CSI-2 capture"
	depends on VIDEO_DEV
	depends on ARCH_MEDIATEK || COMPILE_TEST
	depends on OF
	select MEDIA_CONTROLLER
	select VIDEO_V4L2_SUBDEV_API
	select VIDEOBUF2_DMA_CONTIG
	select V4L2_FWNODE
	help
	  Say Y or M here to enable the V4L2 capture path of the MediaTek
	  MT6735/MT6755/MT6797 (Helio) SoCs.  The driver exposes the Camera
	  Serial Interface (CSI-2 receiver) together with the CamSV DMA
	  engines as Media Controller video nodes carrying raw Bayer frames
	  read out of the sensor via the SMIs.

	  Sensors are attached as V4L2 sub-devices via their OF endpoints
	  and the camera CSI port nodes.  Requires a device tree describing
	  both the seninf/camsv nodes and the sensor endpoint.

endmenu
```

## drivers/misc/mediatek/Kconfig
```kconfig
# SPDX-License-Identifier: GPL-2.0-only
#
# MediaTek specific drivers

menu "MediaTek SoC drivers"
	depends on ARCH_MEDIATEK || COMPILE_TEST

source "drivers/misc/mediatek/connsys/Kconfig"
source "drivers/misc/mediatek/eccci/Kconfig"

endmenu
```

## drivers/misc/mediatek/connsys/Kconfig
```kconfig
# SPDX-License-Identifier: GPL-2.0-only

config MTK_CONNSYS
	tristate "MediaTek CONSYS Wi-Fi/BT/GPS combo controller"
	depends on ARCH_MEDIATEK || COMPILE_TEST
	depends on OF
	depends on CFG80211
	help
	  Say Y to enable the driver for the MediaTek CONNSYS combo
	  connectivity subsystem found on the MT6735/MT6737M, MT6750/MT6755
	  and MT6797 SoCs.  Choose M to build it as a module.

	  The driver provides the STP (Serial Transport Protocol) and WMT
	  control stacks plus the character devices the vendor userspace
	  relies on:

	    /dev/wmtdetect  chip detection and stack bring-up
	    /dev/stpwmt     WMT control and MCU firmware loading
	    /dev/stpbt      Bluetooth HCI (STP channel 0)
	    /dev/stpgps     GPS NMEA / MNLD (STP channel 2)
	    /dev/wmtWifi    Wi-Fi power and mode control

	  It also loads the MCU ROM patch and Wi-Fi RAM code firmware
	  (ROMv2_lm_patch*.bin / ROMv3_patch*.bin and WIFI_RAM_CODE_*) from
	  the firmware search path.

	  If unsure, say N.
```

## drivers/misc/mediatek/eccci/Kconfig
```kconfig
# SPDX-License-Identifier: GPL-2.0-only
#
# MediaTek MD1 cellular modem (ECCCI)

config MTK_ECCCI
	tristate "MediaTek MD1 cellular modem (ECCCI)"
	depends on ARCH_MEDIATEK || COMPILE_TEST
	depends on ARM64 || COMPILE_TEST
	select FW_LOADER
	help
	  Say Y here to enable the ECCCI driver suite for the MD1 cellular
	  modem found in the MediaTek MT6735/MT6737M, MT6750/MT6753/MT6755
	  and MT6797 SoCs.

	  The suite covers the CLDMA DMA rings used to carry CCCI packets
	  between the AP and the modem, the CCIF doorbell, the character
	  ports (/dev/ccci_fs, /dev/ttyC0, /dev/ttyC1, /dev/ccci_monitor,
	  /dev/ccci_ioctl0..4, /dev/ccci_ipc_* and /dev/ccci_aud) and the
	  ccmni0..ccmni7 network interfaces that carry the cellular IP
	  bearers.

	  The modem firmware is loaded from "modem_1_wg_n.img" through the
	  firmware loader, the optional companion DSP image from
	  "dsp_1_wg_n.bin".

	  To compile this driver as a module, choose M here: the module will
	  be called mtk_eccci.

config MTK_ECCCI_DEBUG
	bool "ECCCI verbose register and packet tracing"
	depends on MTK_ECCCI
	help
	  Enable the dev_dbg() traces of the CLDMA and port layers. They are
	  very verbose, only enable them while debugging a modem bring-up.
```
