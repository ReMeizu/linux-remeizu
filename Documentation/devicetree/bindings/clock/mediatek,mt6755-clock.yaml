## Documentation/devicetree/bindings/clock/mediatek,mt6755-clock.yaml
```yaml
# SPDX-License-Identifier: (GPL-2.0-only OR BSD-2-Clause)
%YAML 1.2
---
$id: http://devicetree.org/schemas/clock/mediatek,mt6755-clock.yaml#
$schema: http://devicetree.org/meta-schemas/core.yaml#

title: MediaTek MT6755 Clock Controllers

maintainers:
  - Arseniy Velikanov <adomerlee@gmail.com>

description: |
  MT6755 top clock multiplexers, infrastructure gates and mixed-signal PLLs.
  The mixed-signal provider currently reads boot firmware PLL configuration;
  PLL rate and power transitions require separate FHCTL support.

properties:
  compatible:
    oneOf:
      - const: mediatek,mt6755-apmixedsys
      - items:
          - enum:
              - mediatek,mt6755-infrasys
              - mediatek,mt6755-topckgen
          - const: syscon

  reg:
    maxItems: 1

  clocks:
    maxItems: 1

  clock-names:
    const: clk26m

  '#clock-cells':
    const: 1

required:
  - compatible
  - reg
  - '#clock-cells'

allOf:
  - if:
      properties:
        compatible:
          contains:
            const: mediatek,mt6755-apmixedsys
    then:
      required:
        - clocks
        - clock-names
    else:
      properties:
        clocks: false
        clock-names: false

additionalProperties: false
```

## Documentation/devicetree/bindings/display/panel/fitipower,ft8716.yaml
```yaml
# SPDX-License-Identifier: (GPL-2.0-only OR BSD-2-Clause)
%YAML 1.2
---
$id: http://devicetree.org/schemas/display/panel/fitipower,ft8716.yaml#
$schema: http://devicetree.org/meta-schemas/core.yaml#

title: Fitipower FT8716 1080x1920 MIPI-DSI panel

maintainers:
  - ReMeizu <rap.player2006@gmail.com>

description: |
  The FT8716 is a 4-lane MIPI-DSI panel controller used in the Meizu MX6
  (1080x1920, RGB888, burst video mode).

allOf:
  - $ref: panel-common.yaml#

properties:
  compatible:
    const: fitipower,ft8716

  reg:
    maxItems: 1

  reset-gpios: true
  port: true

  vddi-supply:
    description: 1.8 V digital supply

  avdd-supply:
    description: Positive bias rail (TPS65132 VPOS)

  avee-supply:
    description: Negative bias rail (TPS65132 VNEG)

required:
  - compatible
  - reg
  - reset-gpios
  - vddi-supply

additionalProperties: false

examples:
  - |
    #include <dt-bindings/gpio/gpio.h>

    panel@0 {
        compatible = "fitipower,ft8716";
        reg = <0>;

        vddi-supply = <&vddi18>;
        reset-gpios = <&pio 180 GPIO_ACTIVE_LOW>;

        port {
            panel_in: endpoint {
                remote-endpoint = <&dsi0_out>;
            };
        };
    };

...
```

## Documentation/devicetree/bindings/mfd/mediatek,mt6351.yaml
```yaml
# SPDX-License-Identifier: (GPL-2.0-only OR BSD-2-Clause)
%YAML 1.2
---
$id: http://devicetree.org/schemas/mfd/mediatek,mt6351.yaml#
$schema: http://devicetree.org/meta-schemas/core.yaml#

title: MediaTek MT6351 PMIC

maintainers:
  - forge <rap.player2006@gmail.com>

description: |
  MT6351 is connected to the SoC PMIC wrapper. The interrupt controller
  has four banks of 16 interrupt slots. Storage regulator support covers
  VEMC, VMCH and VMC on E2/E3 revisions.

properties:
  compatible:
    const: mediatek,mt6351

  interrupts:
    maxItems: 1

  interrupt-controller: true

  "#interrupt-cells":
    const: 2

  "#address-cells":
    const: 0

  regulators:
    type: object
    $ref: /schemas/regulator/mediatek,mt6351-regulator.yaml
    unevaluatedProperties: false

required:
  - compatible
  - interrupts
  - interrupt-controller
  - "#interrupt-cells"
  - regulators

additionalProperties: false
```

## Documentation/devicetree/bindings/mfd/mediatek,mt6353.yaml
```yaml
# SPDX-License-Identifier: (GPL-2.0-only OR BSD-2-Clause)
%YAML 1.2
---
$id: http://devicetree.org/schemas/mfd/mediatek,mt6353.yaml#
$schema: http://devicetree.org/meta-schemas/core.yaml#

title: MediaTek MT6353 PMIC (storage rails)

maintainers:
  - forge <rap.player2006@gmail.com>

description: |
  MT6353 is connected to the SoC through the MediaTek PMIC wrapper. Only the
  storage LDOs (VEMC, VMCH, VMC) are supported so far; the interrupt
  controller, RTC, keys and the remaining regulators are not implemented.
  The legacy interrupt register bank (INT_CON0 0x02b8 / INT_STATUS0 0x02d6)
  does not match any supported MediaTek PMIC interrupt layout, so the nIRQ
  line is optional and no interrupt-controller properties are accepted.

properties:
  compatible:
    const: mediatek,mt6353

  interrupts:
    maxItems: 1
    description: |
      Optional PMIC nIRQ line. It is not used by the storage-only driver and
      the EINT number is unproven, so boards should currently omit it.

  "#address-cells":
    const: 0

  regulators:
    type: object
    $ref: /schemas/regulator/mediatek,mt6353-regulator.yaml
    unevaluatedProperties: false

required:
  - compatible
  - regulators

additionalProperties: false
```

## Documentation/devicetree/bindings/pinctrl/mediatek,mt6735-pinctrl.yaml
```yaml
# SPDX-License-Identifier: (GPL-2.0-only OR BSD-2-Clause)
%YAML 1.2
---
$id: http://devicetree.org/schemas/pinctrl/mediatek,mt6735-pinctrl.yaml#
$schema: http://devicetree.org/meta-schemas/core.yaml#

title: MediaTek MT6735 and MT6735M pin controller

maintainers:
  - Sean Wang <sean.wang@kernel.org>

properties:
  compatible:
    enum:
      - mediatek,mt6735-pinctrl
      - mediatek,mt6735m-pinctrl

  reg:
    maxItems: 8

  reg-names:
    items:
      - const: gpio
      - const: iocfg0
      - const: iocfg1
      - const: iocfg2
      - const: iocfg3
      - const: iocfg4
      - const: iocfg5
      - const: eint

  gpio-controller: true
  '#gpio-cells':
    const: 2
  gpio-ranges:
    maxItems: 1
  interrupt-controller: true
  '#address-cells':
    const: 0
  '#interrupt-cells':
    const: 2
  interrupts:
    maxItems: 1

patternProperties:
  '-pins$':
    type: object
    additionalProperties: false
    patternProperties:
      '^pins':
        type: object
        $ref: pinmux-node.yaml#
        additionalProperties: false
        properties:
          pinmux: true
          bias-disable: true
          bias-pull-up: true
          bias-pull-down: true
          input-enable: true
          input-disable: true
          input-schmitt-enable: true
          input-schmitt-disable: true
          output-high: true
          output-low: true
        required:
          - pinmux

required:
  - compatible
  - reg
  - reg-names
  - gpio-controller
  - '#gpio-cells'
  - gpio-ranges
  - interrupt-controller
  - '#interrupt-cells'
  - interrupts

additionalProperties: false
```

## Documentation/devicetree/bindings/pinctrl/mediatek,mt6755-pinctrl.yaml
```yaml
# SPDX-License-Identifier: (GPL-2.0-only OR BSD-2-Clause)
%YAML 1.2
---
$id: http://devicetree.org/schemas/pinctrl/mediatek,mt6755-pinctrl.yaml#
$schema: http://devicetree.org/meta-schemas/core.yaml#

title: MediaTek MT6750 and MT6755 Pin Controllers

maintainers:
  - Sean Wang <sean.wang@kernel.org>

description: |
  The GPIO block and six IOCFG blocks control 190 pins. The external interrupt
  controller has 160 lines and 16 hardware debounce counters. GPIOs 160 through
  189 do not have a linear external interrupt mapping.

properties:
  compatible:
    enum:
      - mediatek,mt6750-pinctrl
      - mediatek,mt6755-pinctrl

  reg:
    minItems: 8
    maxItems: 8

  reg-names:
    items:
      - const: gpio
      - const: iocfg0
      - const: iocfg1
      - const: iocfg2
      - const: iocfg3
      - const: iocfg4
      - const: iocfg5
      - const: eint

  gpio-controller: true
  gpio-ranges:
    maxItems: 1

  '#gpio-cells':
    const: 2

  interrupt-controller: true
  interrupts:
    maxItems: 1

  '#interrupt-cells':
    const: 2

  '#address-cells':
    const: 0

required:
  - compatible
  - reg
  - reg-names
  - gpio-controller
  - gpio-ranges
  - '#gpio-cells'
  - interrupt-controller
  - interrupts
  - '#interrupt-cells'

allOf:
  - $ref: pinctrl.yaml#

patternProperties:
  '-pins$':
    type: object
    additionalProperties: false

    patternProperties:
      '^pins':
        type: object
        $ref: /schemas/pinctrl/pincfg-node.yaml#
        additionalProperties: false
        properties:
          pinmux:
            $ref: /schemas/types.yaml#/definitions/uint32-array
            description: Pin number in bits 15:8 and mux function in bits 3:0.
          bias-disable: true
          bias-pull-up: true
          bias-pull-down: true
          input-enable: true
          input-disable: true
          input-schmitt-enable: true
          input-schmitt-disable: true
          output-high: true
          output-low: true
        required:
          - pinmux

additionalProperties: false
```

## Documentation/devicetree/bindings/pinctrl/mediatek,mt6797-pinctrl.yaml
```yaml
# SPDX-License-Identifier: (GPL-2.0-only OR BSD-2-Clause)
%YAML 1.2
---
$id: http://devicetree.org/schemas/pinctrl/mediatek,mt6797-pinctrl.yaml#
$schema: http://devicetree.org/meta-schemas/core.yaml#

title: MediaTek MT6797 Pin and External Interrupt Controller

maintainers:
  - forge <rap.player2006@gmail.com>

description: |
  MT6797 has 262 physical GPIOs and 192 external interrupt slots.
  The internal PMIC signal occupies EINT176 and has no physical GPIO
  register. Interrupt specifiers use EINT numbers, not the vendor BSP's
  translated GPIO numbers. The driver currently supports GPIO direction,
  level, function muxing and EINT; electrical pad controls need separate
  register descriptions.

properties:
  compatible:
    const: mediatek,mt6797-pinctrl

  reg:
    maxItems: 6

  reg-names:
    items:
      - const: gpio
      - const: iocfgl
      - const: iocfgb
      - const: iocfgr
      - const: iocfgt
      - const: eint

  gpio-controller: true

  "#gpio-cells":
    const: 2

  gpio-ranges:
    maxItems: 1

  interrupt-controller: true

  "#interrupt-cells":
    const: 2

  "#address-cells":
    const: 0

  interrupts:
    maxItems: 1

patternProperties:
  "-pins$":
    type: object
    additionalProperties: false
    patternProperties:
      "^pins":
        type: object
        additionalProperties: false
        properties:
          pinmux:
            $ref: /schemas/types.yaml#/definitions/uint32-array
        required:
          - pinmux

required:
  - compatible
  - reg
  - reg-names
  - gpio-controller
  - "#gpio-cells"
  - gpio-ranges
  - interrupt-controller
  - "#interrupt-cells"
  - interrupts

additionalProperties: false
```

## Documentation/devicetree/bindings/regulator/mediatek,mt6328-regulator.yaml
```yaml
# SPDX-License-Identifier: (GPL-2.0-only OR BSD-2-Clause)
%YAML 1.2
---
$id: http://devicetree.org/schemas/regulator/mediatek,mt6328-regulator.yaml#
$schema: http://devicetree.org/meta-schemas/core.yaml#

title: MediaTek MT6328 regulators

maintainers:
  - Yassine Oudjana <y.oudjana@protonmail.com>

description:
  Buck converters and low-dropout supplies of the MT6328 PMIC. The regulator
  controller is a child of the MT6328 multifunction device.

properties:
  compatible:
    const: mediatek,mt6328-regulator

patternProperties:
  '^(buck_v(pa|proc|core1|sys22|lte)|ldo_v(aux18|tcxo_[01]|aud28|cn28|cama|cn33_bt|cn33_wifi|usb33|efuse|sim[12]|emc_3v3|mch|tref|mc|camaf|ibr|io28|gp1|camd|rf18_[01]|io18|cn18|camio|sram|m))$':
    type: object
    $ref: regulator.yaml#
    unevaluatedProperties: false

required:
  - compatible

additionalProperties: false
```

## Documentation/devicetree/bindings/regulator/mediatek,mt6353-regulator.yaml
```yaml
# SPDX-License-Identifier: (GPL-2.0-only OR BSD-2-Clause)
%YAML 1.2
---
$id: http://devicetree.org/schemas/regulator/mediatek,mt6353-regulator.yaml#
$schema: http://devicetree.org/meta-schemas/core.yaml#

title: MediaTek MT6353 Storage Regulators

maintainers:
  - forge <rap.player2006@gmail.com>

description: |
  VEMC, VMCH and VMC LDOs of the MT6353 PMIC. Register addresses and voltage
  tables come from the MediaTek 3.18 BSP: VEMC/VMCH select 2.9/3.0/3.3 V,
  VMC selects 1.2/1.3/1.5/1.8/2.5/2.9/3.0/3.3 V. The regulators node is a
  child of the MT6353 PMIC node; it is instantiated by the MT6397 MFD cell
  name, so no compatible is required.

patternProperties:
  "^ldo-v(emc|mch|mc)$":
    type: object
    $ref: regulator.yaml#
    unevaluatedProperties: false
    required:
      - regulator-name
      - regulator-min-microvolt
      - regulator-max-microvolt

additionalProperties: false
```

## Documentation/devicetree/bindings/timer/mediatek,mt6750-cpuxgpt.yaml
```yaml
# SPDX-License-Identifier: (GPL-2.0-only OR BSD-2-Clause)
%YAML 1.2
---
$id: http://devicetree.org/schemas/timer/mediatek,mt6750-cpuxgpt.yaml#
$schema: http://devicetree.org/meta-schemas/core.yaml#

title: MediaTek MT6750 Secure CPUXGPT System Counter

maintainers:
  - Matthias Brugger <matthias.bgg@gmail.com>

description: |
  The CPUXGPT feeds the ARM architected system counter. The MCUSYS register
  window contains data and index words at offsets 0 and 4. Writes require the
  legacy MediaTek MCUSYS SiP SMC32 service 0x82000201, including index selection
  before an MMIO data read. The input clock is 26 MHz and the counter runs at
  13 MHz. ARM architected timer PPIs provide clock events; CPUXGPT comparator
  interrupts are not used by this driver.

properties:
  compatible:
    const: mediatek,mt6750-cpuxgpt

  reg:
    maxItems: 1
    description: Eight-byte CPUXGPT data/index window in MCUSYS.

  clocks:
    maxItems: 1
    description: 26 MHz input clock.

required:
  - compatible
  - reg
  - clocks

additionalProperties: false
```
